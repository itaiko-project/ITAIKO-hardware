/*
████████████████████████████████████████████████████████████████████████████████████████████████████████████████████████████████
█████████                                                                                                               ████████
████████                                                                                                                 ███████
████████   ████████████████████████████████████████████████████████████████████████   ████████████████████████████████   ███████
████████  ██        █                     █                     █        █        ██ ██       ██                     ██  ███████
████████  █  ██████   ███████████████████   ███████████████████   ██████   ██████  ███  █████    ███████████████████  █  ███████
████████  █ ████████ █████████████████████ █████████████████████ ████████ ████████ █  █████████ █████████████████████ █  ███████
████████  █ ████████ █████████████████████ ██████████ ██████████ ████████ ████████ ███████████  ██████████ ██████████ █  ███████
████████  █ ████████ █████████████████████ ██████████ ██████████ ████████ ███████████████████   ██████████ ██████████ █  ███████
████████  █ ████████  ███████████████████  ██████████ ██████████ ████████ ██████████████████  █ ██████████ ██████████ █  ███████
████████  █ ████████       █████████       ██████████ ██████████ ████████ █████████████████  ██ ██████████ ██████████ █  ███████
████████  █ ████████ █████ █████████ █████ ██████████ ██████████ ████████ ████████████████  ██  ██████████ ██████████ █  ███████
████████  █ ████████ ██ ██ █████████ ██ ██ █████████████████████ ████████ ███████████████  ██   ██████████ ██████████ █  ███████
████████  █ ████████ █   █ █████████ █   █ █████████████████████ ████████ ████████████████  ██  ██████████ ██████████ █  ███████
████████  █ ████████ █ █ █ █████████ █ █ █ ██████████ ██████████ ████████ █████████████████  ██ ██████████ ██████████ █  ███████
████████  █ ████████ █ █ █ █████████ █ █ █ ██████████ ██████████ ████████ ██████████████████  █ ██████████ ██████████ █  ███████
████████  █ ████████ █ █ █ █████████ █ █ █ ██████████ ██████████ ████████ ███████████████████   ██████████ ██████████ █  ███████
████████  █ ████████ █ █ █ █████████ █ █ █ ██████████ ██████████ ████████ ████████ ███████████  ██████████ ██████████ █  ███████
████████  █ ████████ █ █ █ █████████ █ █ █ ██████████ ██████████ ████████ ████████   ██████████ ██████████ ██████████ █  ███████
████████  █ ████████ █ █ █ █████████ █ █ █ ██████████ ██████████ ████████ ████████ ██  ████████ █████████████████████ █  ███████
████████  █  ██████  █ █ █  ███████  █ █ █  ████████   ████████   ██████   ██████  █ ██  █████   ███████████████████  █  ███████
████████  ██        ██ █ ██         ██ █ ██          █          █        █        ██  ██       █                     ██  ███████
████████   ██████████  █  ███████████  █  █████████████████████████████████████████    ███████████████████████████████   ███████
████████               █               █                                                                                 ███████
█████████             ███             ███                                                                               ████████
████████████████████████████████████████████████████████████████████████████████████████████████████████████████████████████████

ITAIKO by danstronics, credits to kasashiki with HIDTaiko (https://github.com/kasasiki3/HIDtaiko) for his original algorithm.
The values here were calibrated for MY DRUM, your readings will be different!!
PLEASE spend some time calibrating everything and getting used to the drum!!!
*/

#include <Keyboard.h>
#include <SPI.h>
#include <Wire.h>
#include <Adafruit_GFX.h>
#include <Adafruit_SSD1306.h>

//OLED Setup
#define OLED_RESET 4
TwoWire oled(i2c1, 6, 7); //Please check the i2c bus (if i2c0 or i2c1) and pins!!
Adafruit_SSD1306 display(128, 64, &oled, OLED_RESET);

//ITAIKO Bootscreen
const unsigned char itaikoLogo [] PROGMEM = 
{
  0x00, 0x00, 0x00, 0x00, 0x00, 0x00, 0x00, 0x00, 0x00, 0x00, 0x00, 0x00, 0x00, 0x00, 0x00, 0x00, 
	0x00, 0x00, 0x00, 0x00, 0x00, 0x00, 0x00, 0x00, 0x00, 0x00, 0x00, 0x00, 0x00, 0x00, 0x00, 0x00, 
	0x00, 0x00, 0x00, 0x00, 0x00, 0x00, 0x00, 0x00, 0x00, 0x00, 0x00, 0x00, 0x00, 0x00, 0x00, 0x00, 
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	0x00, 0x00, 0x00, 0x00, 0x00, 0x00, 0x00, 0x00, 0x00, 0x00, 0x00, 0x00, 0x00, 0x00, 0x00, 0x00
};

//Button assignments
#define LEFT_KAT_BTN 'D'
#define LEFT_DON_BTN 'F'
#define RIGHT_DON_BTN 'J'
#define RIGHT_KAT_BTN 'K'

//Button pins
#define BTN_A        2     //South
#define BTN_R        0     //R
#define BTN_X        1     //North
#define BTN_START    3     //Start
#define BTN_Y        8     //East
#define BTN_B        4     //West
#define BTN_HOME1    5     //Home
#define BTN_DOWN     9     //Down
#define BTN_RIGHT    10    //Right
#define BTN_SCREEN   11    //Share
#define BTN_UP       13    //Up
#define BTN_SELECT   14    //Select
#define BTN_LEFT     12    //Left
#define BTN_L        15    //L

//Keyboard key mappings
#define KEY_A        KEY_RETURN
#define KEY_R        'R'
#define KEY_X        'X'
#define KEY_START    KEY_ESC
#define KEY_Y        'Y'
#define KEY_B        'B'
#define KEY_HOME1    KEY_LEFT_GUI
#define KEY_DOWN     KEY_DOWN_ARROW
#define KEY_RIGHT    KEY_RIGHT_ARROW
#define KEY_SCREEN   'P'
#define KEY_UP       KEY_UP_ARROW
#define KEY_SELECT   'Q'
#define KEY_LEFT     KEY_LEFT_ARROW
#define KEY_L        'L'

const uint8_t btnPins[] = {
  BTN_A, BTN_R, BTN_X, BTN_START, BTN_Y, BTN_B, BTN_HOME1,
  BTN_DOWN, BTN_RIGHT, BTN_SCREEN, BTN_UP, BTN_SELECT, BTN_LEFT, BTN_L
};

const uint8_t btnKeys[] = {
  KEY_A, KEY_R, KEY_X, KEY_START, KEY_Y, KEY_B, KEY_HOME,
  KEY_DOWN, KEY_RIGHT, KEY_SCREEN, KEY_UP, KEY_SELECT, KEY_LEFT, KEY_L
};

bool btnStates[14] = {false};  //To track previous states


//Pin assignments
#define LEFT_KAT_PIN A3
#define LEFT_DON_PIN A2
#define RIGHT_DON_PIN A1
#define RIGHT_KAT_PIN A0

/*How much a key is held after you hit the drum.
Some taiko games need this to be at least 10/20ms*/
#define KEYPRESS_DURATION 10

/*RP2040 has very noisy ADC, sensor readings below
this value will be ignored. Decrease for higher sensibility*/
#define INTERFERENCE 100

//Set to 1 to print sensor values in serial monitor
#define DEBUG 1

// Sensibility of the piezos, r = right, l = left, d = red note, k= blue note
int lk_sens = 40;
int ld_sens = 20;
int rd_sens = 16;
int rk_sens = 22;

// Current sensor value read from the piezos
int curr_lk = 0;
int curr_ld = 0;
int curr_rd = 0;
int curr_rk = 0;

// Last sensor value read from the piezos
int last_lk = 0;
int last_ld = 0;
int last_rd = 0;
int last_rk = 0;

// Last time the piezos triggered an input
unsigned long lastTime_lk = 0;
unsigned long lastTime_ld = 0;
unsigned long lastTime_rd = 0;
unsigned long lastTime_rk = 0;

unsigned long lastTime_generic = 0; // last time a piezo gave input
unsigned long lastTime_kats = 0; // last time a kat (blue note) piezo gave input
unsigned long lastTime_dons = 0; // last time a don (red note) piezo gave input

// Various delays
int delayGeneric = 20; //Set this to 0 to have double hit mode
int delaySelf = 40; //Time before the same sensor can be read again
int delayKats = 45; //Time to wait to register another kat after hitting a kat
int delayDons = 40; //Time to wait to register another don after hitting a don
int delayDonsToKats = 55; //Time to wait to register a kat after hitting a don
int delayKatsToDons = 45; //Time to wait to register a don after hitting a kat

void setup() {
  Keyboard.begin();

  #ifdef DEBUG
  Serial.begin(9600);
  #endif

  for (int i = 0; i < 14; i++){
    pinMode(btnPins[i], INPUT_PULLUP);
  }
}

void loop() {
  unsigned long time = millis(); //Current time in ms

  if(!BOOTSEL){ //Pressing the BOOT button will stop the inputs, use this when you set the sensitivity too low!
  curr_lk = analogRead(LEFT_KAT_PIN);
  curr_ld = analogRead(LEFT_DON_PIN);
  curr_rd = analogRead(RIGHT_DON_PIN);
  curr_rk = analogRead(RIGHT_KAT_PIN);

  // Left Kat
  if(curr_lk - last_lk > lk_sens && curr_lk > INTERFERENCE &&
     time - lastTime_generic > delayGeneric &&
     time - lastTime_lk > delaySelf &&
     time - lastTime_rk > delayKats &&
     time - lastTime_dons > delayDonsToKats) {
    
    time = millis();
    last_lk = curr_lk;
    lastTime_lk = time;
    lastTime_kats = time;
    lastTime_generic = time;

    Keyboard.press(LEFT_KAT_BTN);
    delay(KEYPRESS_DURATION);
    Keyboard.release(LEFT_KAT_BTN);

    #ifdef DEBUG
    Serial.print("Left Kat pressed, Sensor Value: ");
    Serial.println(curr_lk);
    #endif
  }

  // Left Don
  if(curr_ld - last_ld > ld_sens && curr_ld > INTERFERENCE &&
     time - lastTime_generic > delayGeneric &&
     time - lastTime_ld > delaySelf &&
     time - lastTime_dons > delayDons &&
     time - lastTime_kats > delayKatsToDons) {
    
    time = millis();
    last_ld = curr_ld;
    lastTime_ld = time;
    lastTime_dons = time;
    lastTime_generic = time;

    Keyboard.press(LEFT_DON_BTN);
    delay(KEYPRESS_DURATION);
    Keyboard.release(LEFT_DON_BTN);

    #ifdef DEBUG
    Serial.print("Left Don pressed, Sensor Value: ");
    Serial.println(curr_ld);
    #endif
  }

  // Right Don
  if(curr_rd - last_rd > rd_sens && curr_rd > INTERFERENCE &&
     time - lastTime_generic > delayGeneric &&
     time - lastTime_rd > delaySelf &&
     time - lastTime_dons > delayDons &&
     time - lastTime_kats > delayKatsToDons) {
    
    time = millis();
    last_rd = curr_rd;
    lastTime_rd = time;
    lastTime_dons = time;
    lastTime_generic = time;

    Keyboard.press(RIGHT_DON_BTN);
    delay(KEYPRESS_DURATION);
    Keyboard.release(RIGHT_DON_BTN);

    #ifdef DEBUG
    Serial.print("Right Don pressed, Sensor Value: ");
    Serial.println(curr_rd);
    #endif
  }

  // Right Kat
  if(curr_rk - last_rk > rk_sens && curr_rk > INTERFERENCE &&
     time - lastTime_generic > delayGeneric &&
     time - lastTime_rk > delaySelf &&
     time - lastTime_lk > delayKats &&
     time - lastTime_dons > delayDonsToKats) {
    
    time = millis();
    last_rk = curr_rk;
    lastTime_rk = time;
    lastTime_kats = time;
    lastTime_generic = time;

    Keyboard.press(RIGHT_KAT_BTN);
    delay(KEYPRESS_DURATION);
    Keyboard.release(RIGHT_KAT_BTN);

    #ifdef DEBUG
    Serial.print("Right Kat pressed, Sensor Value: ");
    Serial.println(curr_rk);
    #endif
  }

  last_lk = curr_lk;
  last_ld = curr_ld;
  last_rd = curr_rd;
  last_rk = curr_rk;
}

  for (int i = 0; i < 14; i++) {
    bool pressed = digitalRead(btnPins[i]) == LOW; //LOW = BTN pressed!
    if (pressed && !btnStates[i]) {
      Keyboard.press(btnKeys[i]);
      btnStates[i] = true;
    } else if (!pressed && btnStates[i]) {
      delay (KEYPRESS_DURATION);
      Keyboard.release(btnKeys[i]);
      btnStates[i] = false;
    }
  }
}

//The core1 manages the OLED
void setup1() {
  display.begin(SSD1306_SWITCHCAPVCC, 0x3C);  //0x3c is the OLED address
  display.clearDisplay();
  display.drawBitmap(0, 0, itaikoLogo, 128, 64, WHITE);
  display.display();
  delay(1500);
}

void loop1() {
  display.clearDisplay();
  display.setTextSize(1);
  display.setTextColor(WHITE);
  display.setCursor(0, 0);
  display.print("L kat reading: ");
  display.println(curr_lk);
  display.print("L don reading: ");
  display.println(curr_ld);
  display.print("R don reading: ");
  display.println(curr_rd);
  display.print("R kat reading: ");
  display.println(curr_rk);
  display.print("L kat sens: ");
  display.println(lk_sens);
  display.print("L don sens: ");
  display.println(ld_sens);
  display.print("R don sens: ");
  display.println(rd_sens);
  display.print("R kat sens: ");
  display.println(rk_sens);
  display.display();
  }